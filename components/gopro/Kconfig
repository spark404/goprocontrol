## components/gopro/Kconfig
```kconfig
menu "GoPro Wifi Configuration"

    config GOPRO_WIFI_SSID
        string "GoPro SSID"
        default "SparkNet"
        help
            The SSID of the GOPRO to connect to

    config GOPRO_WIFI_PASSWORD
        string "GoPro Password"
        default "secret"
        help
            The secret to connect to the gopro

    config GOPRO_MAC_ADDRESS
        string "MAC"
        default ""
        help
            The mac address of the GoPro. Can be set here and it will be retrieved when
            the camera is connected for the first time.

            If set this will be used to send the magic WOL packet

endmenu
```

## components/mavlink_v2/Kconfig
```kconfig
menu "MAVLinkV2 Configuration"
    config MAVLINK_SYSTEM_ID
        int "System ID"
        range 1 255
        default 1
        help
            Unique system id for this device

    config MAVLINK_COMPONENT_ID
        int "Component ID (a MAV_COMPONENT value)"
        range 1 255
        default 100
        help
            Default 100 (Camera #1)

    choice MAVLINK_UART
        prompt "Which UART to use to mavlink communication"

    config MAVLINK_UART_0
        bool "UART0"

    config MAVLINK_UART_1
        bool "UART1"

    config MAVLINK_UART_2
        bool "UART2"

    endchoice

    config MAVLINK_UART_CUSTOM_PINS
        bool "Use custom uart pins"

    config MAVLINK_UART_TX_PIN
        depends on MAVLINK_UART_CUSTOM_PINS
        int "TX Pin"
        range 0 34
        default 4
        help
            GPIO number (IOxx) to use for transmit

            Some GPIOs are used for other purposes (flash connections, etc.) and cannot be used.

            GPIOs 35-39 are input-only so cannot be used as outputs.

    config MAVLINK_UART_RX_PIN
        depends on MAVLINK_UART_CUSTOM_PINS
        int "RX Pin"
        range 0 34
        default 5
        help
            GPIO number (IOxx) to use for receive

            Some GPIOs are used for other purposes (flash connections, etc.) and cannot be used.

            GPIOs 35-39 are input-only so cannot be used as outputs.

endmenu
```

## main/Kconfig.projbuild
```kconfig
menu "GoPro Control Configuration"
    config STATUS_LED_GPIO
        int "GPIO number for the status LED"
        range 0 34
        default 2
        help
            GPIO number (IOxx) to blink on and off.

            Some GPIOs are used for other purposes (flash connections, etc.) and cannot be used to blink.

            GPIOs 35-39 are input-only so cannot be used as outputs.

endmenu
```
